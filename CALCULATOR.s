
;DIRECCION DE LOS RELOJES
RCC_BASE EQU 0x40023800
RCC_AHB1ENR EQU (RCC_BASE + 0X30)
RCC_APB2ENR EQU (RCC_BASE + 0X44)
RCC_APB1ENR EQU (RCC_BASE + 0X40)
	;REGISTROS DE CONFIGURACION
;;;;;;;;;;;;PORTA
GPIOB_BASE EQU 0x40020400 
GPIOB_MODER EQU (GPIOB_BASE + 0x00)
GPIOB_OTYPER EQU (GPIOB_BASE + 0x04)
GPIOB_OSPEEDR EQU (GPIOB_BASE + 0x08)
GPIOB_PUPDR EQU (GPIOB_BASE + 0x0C)
GPIOB_AFRL EQU (GPIOB_BASE + 0x20)
	;REGISTROS DE COMUUNICACION
GPIOB_IDR EQU (GPIOB_BASE + 0x10)
GPIOB_ODR EQU (GPIOB_BASE + 0x14)
GPIOB_BSRR EQU (GPIOB_BASE + 0x18)
;;;;;;;;;;;;;;;;;;;;;;;;;;;;;;
;USART
USART1_BASE EQU 0x40011000 
USART_SR EQU (USART1_BASE + 0X00)
USART_DR EQU (USART1_BASE + 0X04)
USART_BRR EQU (USART1_BASE + 0X08)
USART_CR1 EQU (USART1_BASE + 0X0C)
USART_CR2 EQU (USART1_BASE + 0X10)
	
;NVIC
NVIC_BASE EQU 0xE000E100
NVIC_ISER0 EQU (NVIC_BASE + 0x00)
NVIC_ISER1 EQU (NVIC_BASE + 0x04)	
NVIC_IPR7 EQU (NVIC_BASE + (0x300+(7*4)))
NVIC_IPR9 EQU (NVIC_BASE + (0x300+(4*9)))	
;SYSCONTBLOCK
SCB_AIRCR EQU 0xE000ED0C
	AREA MYDATA,DATA,READWRITE
NUM1 SPACE 14
NUM2 SPACE 14
OPER SPACE 1
CONVERSION SPACE 14
RES SPACE 15
DIGITS SPACE 4
	AREA MYCODE,CODE,READONLY
	ENTRY
	EXPORT __main
	EXPORT USART1_IRQHandler
__main
	BL RCC_CONFG
	BL CONFG_GPIO
	BL CONF_UART
	BL CONFNVIC
LOOP
	CMP R7,#0
	BLGT PART2
	B LOOP
PART2
	EOR R2,R2
	EOR R3,R3
	EOR R0,R0
	EOR R1,R1
	EOR R5,R5
	EOR R4,R4
	LDR R0,=NUM1
OLA	LDRB R1,[R0]
	CMP R1,#'.'
	BEQ DECIMAL
	CMP R1,#0X0D
	BEQ REINT1
	SUB R1,R1,#0X30
	STRB R1,[R0],#1
	B OLA
DECIMAL
	ADD R0,#1
	LDRB R1,[R0]
	CMP R1,#0X0D
	BEQ REINT1
	SUB R1,R1,#0X30
	STRB R1,[R0]
	ADD R4,#1;OBTENGO MI NUMERO DE DIGITOS DECIMALES DEL PRIMER NUMERI
	B DECIMAL
	
	;;;;NUEMRO2;;;;;;;;;;;;;;;;;;;;;;;
	;;;;;;;;;;;;;;;;;;;;;;;;;
	;;;;;;;;;;;;;;;;;;;;
DECODE_2
	EOR R2,R2
	EOR R3,R3
	EOR R0,R0
	EOR R1,R1
	EOR R5,R5
	EOR R4,R4
	EOR R10,R10
	EOR R11,R11
	LDR R0,=NUM2
OLA2	
	LDRB R1,[R0]
	CMP R1,#'.'
	BEQ DECIMAL2
	CMP R1,#0X0D
	BEQ REINT1
	SUB R1,R1,#0X30
	STRB R1,[R0],#1
	B OLA2

DECIMAL2
	ADD R0,#1
	LDRB R1,[R0]
	CMP R1,#0X0D
	BEQ REINT1
	SUB R1,R1,#0X30
	STRB R1,[R0];Guardo mis numero convertidos
	ADD R4,#1;OBTENGO MI NUMERO DE DIGITOS DECIMALES DEL SEGUNDO NUMERO
	ADD R5,#1
	B DECIMAL2
	;;;;;;REINTERPORETAMOS NUMEROS
	;;;;;;;;;;;;;;;;;;;;;;;;;;;;
	;;;;;;;;;;;;;;;;;;;;;;;;;;;
REINT1	;REINT SACA MIS NUMEROS DE LA MEMORIA MI PARTE ENTERA Y LUEGO JUNTA SUS DIGITOS ASCII PARA FORMAR UN SOLO NUMERO ENTERO
	CMP R5,#0;PREGUNTAMOS SI ESTAMOS EN EL PROCESO DEL SEGUNDO NUMERO SI NO ETSAMOS EN EL PRIMERO
	BGT NUMBER2
	LDR R1, =NUM1          ; Cargamos dirección de NUM1
    MOV R0, #0             
    MOV R3, #10 
	B LOOPCON1
NUMBER2
	LDR R1, =NUM2          ; Cargamos dirección de NUM2
    MOV R0, #0             
    MOV R3, #10 
LOOPCON1
    LDRB R2, [R1], #1     
    CMP R2, #0x2E          
    BEQ ENDCON1    
    BL MAC     ; R0 = R0 * 10 + R2 
    B LOOPCON1      ; Repetir hasta encontrar 0x2E
ENDCON1     
	MOV R10,R0;PASO MI NUMERO A R10, DONDE GUARDO MI PARTE ENTERA DEL IEEE
	EOR R0,R0
	RSB R4,#9;CALDULO EL NUMERO DE CEROS DE MI PARTE DECIMAL A PARTIR DEL NUMERO DE DIGITOS
DEX LDRB R2, [R1], #1
	CMP R2, #0x0D
	BEQ EXPONENCIAL
	BL MAC;AHORA CALCULO MI NUMERO EN MI PARTE DECIMAL
	B DEX
EXPONENCIAL
    MUL R0, R3                ; R7 = R7 * 10
    SUBS R4, #1               ; Decrementar contador, RECORDAR QUE EN R4 guardo mi numero de digitos de la parte decimal
	BNE EXPONENCIAL       ; Repetir hasta R5 = 0;DEBO PREGUNTAR POR EL OVERFLOW
    ;MUL R1,R0               ; R1 = R1 * 10^R5 (ej: 25 * 10^7 = 250000000)
	MOV R11,R0
	CMP R10,#0
	BLEQ CEROPOS
	LDR R12,=1000000000
	CMP R5,#0
	BGT ITRIE2
	BL IEEE
DEA	LDR R1,=NUM1
	STR R0,[R1]
	B DECODE_2
ITRIE2
	MOV R9,R8
	BL IEEE
DEA1	MOV R2,R0;en r2 tengo mi segundo numero en ieee
	LDR R1,=NUM2
	STR R2,[R1]
	EOR R7,R7
	B OPERACION
CEROPOS
	CMP R11,#0;SI LA PARTE FRACCIONARIA ES CERO ES UN CERO SEGURO
	BEQ CEROSEG
	BX LR
CEROSEG
	EOR R0,R0
	CMP R5,#0
	BEQ DEA
	B DEA1 
MAC
	UMULL   R0, R6, R0, R3    ; R6:R0 = R0 * R3 (R6 = parte alta, R0 = parte baja)
    ADDS    R0, R0, R2        ; R0 += R2 (actualiza flags NZ)
    CMP R6,#0
	BGT POSINFINIT
	BX      LR
;;;;;;;;;;;;;;;;;;;;;;;;;;;;
;;;;;;;;;;SUBRUTINA DE ESCRITURA;
WRITE_UART
		LDR R0,=USART_DR
		STR R1,[R0]
		LDR R0,=USART_SR
WRITECIC
		LDR R1,[R0]
		TST R1,#(1 << 6)
		BEQ WRITECIC
		BX LR
POSINFINIT
	CMP R5,#0
	BEQ PALLA
	LDR R0,=0X7f800000
	LDR R1,=NUM2
	STR R0,[R1]
	B OPERACION
PALLA	
	LDR R0,=0X7f800000
	LDR R1,=NUM1
	STR R0,[R1]
	B DECODE_2
	
;;;;;;;;;;;;;;;;;;;;;;;;;;;
;;;;;;;;;;;;;;;;;;;;;;;;;;;
;;;;;;;;;;;;;;;;;;;;;;;;;;;
;SUBRUTINA DE IEEE
PUNTOFIJO
	EOR R1,R1
	EOR R4,R4
	MOV R3,#7
	LDR R2,=7
	MOV R7,#16
	LDR R6,=CONVERSION
	
loop
		PUSH{LR}
		MOV R0,R11;ENR11 GUARDO SIEMPRE MI FRACCION
		MOV R1,R12;EN R12 GUARDO MI TOPE
loop1
		LSL R0,#1;DESPLAZO Y PREGUNTO SI ES MENOR A MI TOPE SI ES ASI PONGO CERO
		CMP R0,R1
		BLLT CEROS
		CMP R0,R1
		BLGE UNOS;SI ES IGUAL O MAYOR QUE EL TOPE PONGO 1
		CMP R2,#0
		BEQ CONCAT
		SUB R2,#1
		SUB R3,#1
		B loop1
CEROS
	ORR R4,#0;EN R4 GUARDO MI FRACCION CONVERTIDA
	BX LR
UNOS 
	LDR R5,=1
	LSL R5,R3
	ORR R4,R5;EN R4 GUARDO MI FRACCION CONVERTIDA
	SUB R0,R0,R1
	BX LR
CONCAT
	STRB R4,[R6]
	ADD R6,#1
	MOV R3,#7
	LSR R4,#8
	MOV R2,#7
	SUB R7,#1
	CMP R7,#0
	BNE loop1
	LDR R6,=CONVERSION
	EOR R1,R1
	EOR R3,R3
	MOV R2,#24
LOOP2	
	LDRB R0,[R6]
	LSL R0,R2
	ORR R1,R0
	SUB R2,#8
	ADD R6,#1
	ADD R3,#1
	CMP R3,#4
	BNE LOOP2
	MOV R0,R1
	POP{PC}

IEEE
	PUSH{LR}
	BL PUNTOFIJO
	MOV R1,R10 ;EN R10 IRA SIEMPRE MI ENTERO
	CMP R1,#0
	BNE EXPOSIT;PREGUNTO SI ES MAYOR QUE CERO, SI LO ES MI EXPONENTE ES NEGATIVO
	BL BUSQUEDA
	CMP R0,#0;EN R0 SE ENCUENTRA MI FRACCION
	BEQ CERO
	;CLZ R2,R0;AQUI GUARDO MI POINTSHIFT
	LSL R0,R5
	LDR R1,=0x7FFFFFFF
	AND R0,R1
	LSR R0,#8
	ADD R2,#1
	RSB R2,#127;A 127 LE RESTO MI POINTSHIFT
	LSL R2,#23
	ORR R0,R0,R2
	MOV R1,R9
	LSL R1,#31
	ORR R0,R1
	POP{PC}
EXPOSIT
	MOV R1,R10;en r1 guardo mi entero
	MOV R3,#32;32
	CLZ R2,R1
	SUB R2,R3,R2;cuento cuantos digitos tiene mi parte entera para obtener el exponente PS(Point Shift)
	LSR R0,R2
	CLZ R3,R1
	LSL R1,R3
	ORR R0,R0,R1
	LDR R1,=0x7FFFFFFF
	AND R0,R1
	SUB R2,#1
	LSR R0,#8
	ADD R2,R2,#127
	LSL R2,#23
	ORR R0,R0,R2
	MOV R1,R9;EN R9 ESTA SIEMPRE MI SIGNO
	LSL R1,#31
	ORR R0,R1
	POP{PC}
CERO
	EOR R0,R0
	MOV R1,R9;EN R9 ESTA SIEMPRE MI SIGNO
	LSL R1,#31
	ORR R0,R1
	POP{PC}
	
BUSQUEDA
	EOR R2,R2
	EOR R3,R3
	EOR R4,R4
	MOV R1,#24
	LDR R6,=CONVERSION
XE1	LDRB R0,[R6]
	ADD R6,#1
	CMP R0,#0
	BNE XER
	ADD R2,#8
	B XE1
XER	LSL R0,R1
	ORR R4,R0
	SUB R1,#8
	LDRB R0,[R6]
	ADD R6,#1
	ADD R3,#1
	CMP R3,#4;NUMERO DE VECES QUE SACO DE LA MEMORIA
	BNE XER
	CLZ R5,R4
	ADD R2,R2,R5
	MOV R0,R4
	BX LR	
	LTORG  
OPERACION
	LDR R0,=NUM2
	LDR R0,[R0]
	MOV R2,R0;EN R2 ESTA EL SIGUIENTE NUMERO
	LDR R0,=NUM1
	LDR R0,[R0];EN R0 ESTA EL PRIMER NUMERO
	LDR R1,=0X7f800000
	CMP R0,R1
	BLEQ POSINFIT2
	CMP R2,R1
	BLEQ POSINFIT3
	EOR R1,R1
    MOV     R3, R0
    MOV     R4, R2
    LSRS    R5, R3, #31
    LSRS    R6, R4, #31;EXTRAIGO SIGNOS
    LSLS    R7, R3, #1
    LSRS    R7, R7, #24
    LSLS    R8, R4, #1
    LSRS    R8, R8, #24;EXTRAIGO EXPONENTES EN R7 Y R8 RESPECTIVAMENTE

    MOVW    R11, #0xFFFF
    MOVT    R11, #0x007F
    AND     R9, R3, R11;EXTRAIGO MANTISA SIN SIGNO NI EXPONENTE
    ORR     R9, R9, #(1 << 23);AÑADO BIT IMPLICITO EN AMBOS NUMEROS
    AND     R10, R4, R11
    ORR     R10, R10, #(1 << 23);AÑADO BIT IMPLICITO

    CMP     R7, R8;COMPARO EXPONENTES
    BEQ     EXP_EQUAL;SALTA SI SON IGUALES
    BLT     EXP_B_BIGGER;SALTA SI EL PRIMERO ES MENOR
    SUB     R11, R7, R8;CASO SI ES MAYOR
    CMP     R11, #31
    MOVHI   R10, #0
    LSRLS   R10, R10, R11
    MOV     R12, R7
    B       ALIGNED_EXPS

EXP_B_BIGGER
    SUB     R11, R8, R7;CALCULO DIFERENCIA DE EXPONENTES PARA ALINEAR LAS MANTISAS
    CMP     R11, #31
    MOVHI   R9, #0;SI ES MAS GRANDE DE 31 PONGO EN 0 MANTISA
    LSRLS   R9, R9, R11;DESPLAZO SI ES MAS CHICO LA DIFERENCIA ENTRE AMBOS PARA ALINEAR MANTISA
    MOV     R12, R8
    B       ALIGNED_EXPS

EXP_EQUAL
    MOV     R12, R7; SI SON IGUALES IGUALO EXPONENTES

ALIGNED_EXPS
    LDR     R1, =OPER
    LDRB    R1, [R1]
    CMP     R1, #'+'
    BEQ     DO_ADD
    CMP     R1, #'-';PREGUNTO QUE OPERACION ES
    BEQ     DO_SUB
    B       END_RUTINA

DO_ADD
    CMP     R5, R6;pregunto si sussignos son iguales
    BEQ     ADD_MANTISSAS; si son iguales sumo
    B       SUB_MANTISSAS;si son diferentes resto

DO_SUB
    EOR     R6, R6, #1;invierto el signo del segundo numero
    CMP     R5, R6
    BEQ     ADD_MANTISSAS;si son iguales sumo
    B       SUB_MANTISSAS;si son diferentes resto

ADD_MANTISSAS
    ADD     R9, R9, R10
    TST     R9, #(1 << 24);sumo mantisas y pregunto si hubo carry
    BEQ     SKIP_SHIFT;si no creo mi resultado
    LSRS    R9, R9, #1;si hubo carry ajusto exponente
    ADDS    R12, R12, #1

SKIP_SHIFT
    B       ASSEMBLE_RESULT

SUB_MANTISSAS
    CMP     R9, R10;comparo mantisas si la primera es mayor solo resto
    BHS     MANTA_BIGGER
    SUBS    R9, R10, R9;si la segund es mayor invierto el orden y cambio signo
    MOV     R5, R6
    B       NORMALIZE_RESULT

MANTA_BIGGER
    SUBS    R9, R9, R10
    B       NORMALIZE_RESULT

NORMALIZE_RESULT
    CMP     R9, #0;si mi suba es 0 salto al caso del 0
    BEQ     ZERO_RESULT

NORM_LOOP
    TST     R9, #(1 << 23); de igual forma pregunto por el carry inverso
    BNE     ASSEMBLE_RESULT
    LSLS    R9, R9, #1
    SUBS    R12, R12, #1
    CMP     R12, #0
    BLE     ZERO_RESULT
    B       NORM_LOOP

ZERO_RESULT
    MOV     R0, #0
	MOV R1,'0'
	BL WRITE_UART
    B       END_RUTINA

ASSEMBLE_RESULT
    MOVW    R11, #0xFFFF
    MOVT    R11, #0x007F
    AND     R9, R9, R11
    LSL     R0, R5, #31;junto mantisa, exponente y SIGNO
	CMP R12,#158;PREGUNTO POR LOS INFINITOS
	BGE MASINFI
	CMP R12,#96
	BLE MENOSINFI
    ORR     R0, R0, R12, LSL #23
    ORR     R0, R0, R9
	B INVERTIEEE
END_RUTINA
	B .
MASINFI	
	MOV R1,#0X0D
	BL WRITE_UART
	MOV R1,#0X0A
	BL WRITE_UART
	MOV R1,'+'
	BL WRITE_UART
	MOV R1,'I'
	BL WRITE_UART
	MOV R1,'N'
	BL WRITE_UART
	MOV R1,'F'
	BL WRITE_UART
	B .
MENOSINFI
	MOV R1,#0X0D
	BL WRITE_UART
	MOV R1,#0X0A
	BL WRITE_UART
	MOV R1,'-'
	BL WRITE_UART
	MOV R1,'I'
	BL WRITE_UART
	MOV R1,'N'
	BL WRITE_UART
	MOV R1,'F'
	BL WRITE_UART
	B .
INVERTIEEE
	EOR R8,R8
	MOV R1,R0
	AND R1,#0X80000000;EXTRAIGO EL SIGNO
	LSR R10,R1,#31;EN R10 GUARDO SIGNO
	MOV R3,R0
	CMP R10,#0
	BLNE MENOSMENOS
	MOV R0,R3
	AND R0,#0X7FFFFFFF ;quito signno
	MOV R1,R0
	LDR R2,=0X7F800000
	AND R1,R2;;EXTRAIGO EXPONENTE
	LSR R1,#23
	MOV R11,R1;EN R11 GUARDO EXPONENTE
	MOV R1,R0
	LDR R2,=0X007FFFFF
	AND R1,R2;EXTRAIGO MANTISA
	MOV R12,R1;EN R12 GUARDO MANTISA
	ORR R12,#0x00800000;AGREGO BIT IMPLICITO
	CLZ R0,R12
	LSL R12,R0;AJUTSTAR PRECISION
	CMP R11,#127
	BGT POSITIVE_EXPONENT
	BLT	NEGATIVE_EXPONENT
	BEQ EQUAL
POSITIVE_EXPONENT
	SUB R11,#127;OBTENGO MI NUMERO DE DIGITOS
	ADD R11,#1
	MOV R1,R12
	LSL R1,R11;EN R1 OBTENGO MI PARTE FRACCIONAL
	BL FRACCTODEC
	MOV R9,R0;EN R9 GUARDO MI PARTE FRACCIONAL CONVERTIDA
	SUB R11,#1
	RSB R11,#31
	MOV R0,R12
	LSR R0,R11;EN R0 OBTENGO MI PARTE ENTERA
	BL TOASCII
	EOR R8,R8
	BL TOTERMINAL
	MOV R0,R9
	BL TOASCII
	BL TOTERMINAL
	B .
NEGATIVE_EXPONENT
	RSB R11,#127;OBTENGO MI NUMERO DE DIGITOS
	SUB R11,#1
	LSR R12,R11
	MOV R1,R12
	BL FRACCTODEC
	MOV R9,R0
	BL TOASCII
	BL TOTERMINAL
	B .
EQUAL
	SUB R11,#127;OBTENGO MI NUMERO DE DIGITOS
	ADD R11,#1
	MOV R1,R12
	LSL R1,R11;EN R1 OBTENGO MI PARTE FRACCIONAL
	BL FRACCTODEC
	MOV R9,R0;EN R9 GUARDO MI PARTE FRACCIONAL CONVERTIDA
	SUB R11,#1
	RSB R11,#31
	MOV R0,R12
	LSR R0,R11;EN R0 OBTENGO MI PARTE ENTERA
	BL TOASCII
	EOR R8,R8
	BL TOTERMINAL
	MOV R0,R9
	BL TOASCII
	BL TOTERMINAL
	B .
MENOSMENOS
	PUSH{LR}
	LDR R1,='-'
	BL WRITE_UART
	POP{LR}
	BX LR
TOTERMINAL
	PUSH{LR}
	CMP R8,#0
	BNE POINT
KIO	LDR R2,=DIGITS
	LDRB R2,[R2];NUMERO DE DIGITOS A IMPRIMIR
	LDR R3, =RES
LOP	LDRB R1,[R3],#1
	BL WRITE_UART
	SUB R2,#1
	CMP R2,#0
	BNE LOP
	ADD R8,#1
YIO	POP{LR}
	BX LR
POINT
	LDR R1,='.'
	BL WRITE_UART
	CMP R9,#0
	BEQ YIO
	B KIO
	
TOASCII
	LDR R1, =RES           ; Cargar dirección de RES
    LDR R2, =DIGITS        ; Cargar dirección de DIGITS
    MOV R3, #0             ; Inicializar contador de dígitos
    MOV R4, #10            ; Divisor PARA DIVIDIR N VECES Y OBTENER DIGITO POR DIGITO
    MOV R5, #0             ; Bandera para número cero

    ; Manejar caso especial (número 0)
    CMP R0, #0
    BNE ConvertLoop
    BX LR

ConvertLoop
    UDIV R6, R0, R4        ; R6 = R0 / 10 cociente
    MLS  R7, R6, R4, R0    ; R7 = R0 - (R6*10) resisduoo
    ADD  R7, R7, #'0'      ; Convertir a ASCII
    PUSH {R7}              ; Guard0 dígito en pila 
    ADD  R3, R3, #1        ; IncrementO contador
    MOV  R0, R6            
    CMP  R0, #0            ; PREGUNTO SI LLEGA A 0  SI NO SIGO CONVIRTIENDO DIGITOS Y GUARDANDO EN PILA
    BNE  ConvertLoop

    ; Extraer dígitos de la pila (en orden inverso)
    MOV R6, R3             ; Copiar contador
    LDR R1, =RES           ; Recargar dirección de RES
	LDR R8,=10000
	CMP R9,#0
	BEQ GUARDMEM
	CMP R9,R8
	BLT CERO1
GUARDMEM
    POP {R7}               ; Obtener dígito (MSB primero)
    STRB R7, [R1], #1      ; Guardar en RES y avanzar
    SUBS R6, R6, #1        ; Decrementar contador
    BNE  GUARDMEM
	B CUENTA
CERO1
	LDR R0,='0'
	STRB R0,[R1], #1
	ADD R3,#1
	CMP R9,#1000
	BLT CERO2
	B GUARDMEM
CERO2
	STRB R0,[R1], #1
	ADD R3,#1
	CMP R9,#100
	BLT CERO3
	B GUARDMEM
CERO3
	STRB R0,[R1], #1
	ADD R3,#1
	CMP R9,#10
	BLT CERO4
	B GUARDMEM
CERO4
	STRB R0,[R1], #1
	ADD R3,#1
	CMP R9,#1
	BLT CERO5
	B GUARDMEM
CERO5
	STRB R0,[R1], #1
	ADD R3,#1
	B GUARDMEM
CUENTA
    ; Guardar conteo de dígitos
    LDR R2, =DIGITS
    STR R3, [R2]           ; Guardar contador en DIGITS

    ; Terminador nulo si se necesita cadena
    MOV R7, #0
    STRB R7, [R1]
	BX LR
CEROFRACC
	CMP R9,#0
	BEQ CUENTA
	BX LR
FRACCTODEC
	MOV R0,R1
	MOV R1,#5
	MOV  R2, #10           ; Base decimal
    MOV  R3, #1            ; Inicializar factor (10^0 = 1)
    MOV  R5, R1            ; Copiar contador de dígitos
CALFAC
    MUL  R3, R3, R2        ; R3 = R3 * 10
    SUBS R5, R5, #1        ; Decrementar contador
    BNE  CALFAC   ; Repetir hasta completar

    ; Multiplicar fracción por factor de escala
    ; (R0 * R3) >> 32 (aritmética de 64 bits)
    UMULL R4, R5, R0, R3   ; [R5:R4] = R0 * R3 (64 bits)
    
    ; El resultado entero está en R5 (parte alta de 64 bits)
    MOV  R0, R5            ; Mover resultado a R0
    
    ; Contar dígitos del resultado
    MOV  R1, #0            ; Inicializar contador de dígitos
    MOV  R2, #10           ; Divisor
CONTARDIGITOS
    UDIV R0, R0, R2        ; R0 = R0 / 10
    ADD  R1, R1, #1        ; Incrementar contador
    CMP  R0, #0            ; ¿Terminó?
    BNE  CONTARDIGITOS
    MOV  R0, R5            ; Restaurar resultado (R5 contiene el entero)
	BX LR
POSINFIT2
	CMP R2,R1
	BEQ NAN
	B MASINFI
POSINFIT3
	B MASINFI
NAN
	LDR R1,=0X0A
	BL WRITE_UART
	LDR R1,=0X0D
	BL WRITE_UART
	LDR R1,='N'
	BL WRITE_UART
	LDR R1,='a'
	BL WRITE_UART
	LDR R1,='N'
	BL WRITE_UART
	B .
	
	
	LTORG         
	
;;;;;;;;;;;;;;;; EN LA INTERRUPCION GUARDO MIS NUMEROS;;;;;;;;;;;;;;;;;;;;;;;;;;;;
USART1_IRQHandler
	PUSH{LR}
	CMP R5,#1
	BEQ NUMERO2
	CMP R5,#2	
	BEQ OPERANDO
	LDR R0,=USART_DR
	LDR R1,[R0]
	BL.W WRITE_UART
	LDR R0,=USART_DR
	LDR R1,[R0]
	CMP R1,#'-'
	BLEQ.W MENOS1
	LDR R0,=NUM1
	ADD R0,R4,R0
	STRB R1,[R0]
	ADD R4,#1
	CMP R1,#0X0D;CUANDO PRESIONO ENTER ENTRA AL SIGUIENTE NUMERO PARA GUARDAR
	BEQ PART1
	POP{LR}
	BX LR
MENOS1
	MOV R9,#1
	POP{LR}
	BX LR
MENOS2
	MOV R8,#1
	POP{LR}
	BX LR
ERROR
	MOV R1,#0X0D
	BL WRITE_UART
	MOV R1,#0X0A
	BL WRITE_UART
	MOV R1,'E'
	BL WRITE_UART
	MOV R1,'R'
	BL WRITE_UART
	MOV R1,'R'
	BL WRITE_UART
	MOV R1,'O'
	BL WRITE_UART
	MOV R1,'R'
	BL WRITE_UART
	B .
PART1
	ADD R5,#1
	EOR R4,R4
	MOV R1,#0X0A
	BL.W WRITE_UART
	POP{LR}
	BX LR
NUMERO2
	LDR R0,=USART_DR
	LDR R1,[R0]
	BL WRITE_UART
	LDR R0,=USART_DR
	LDR R1,[R0]
	CMP R1,#'-'
	BLEQ MENOS2
	LDR R0,=NUM2
	ADD R0,R4,R0
	STRB R1,[R0]
	ADD R4,#1
	CMP R1,#0X0D
	BEQ PART1
	POP{LR}
	BX LR
	
OPERANDO
	LDR R0,=USART_DR
	LDR R1,[R0]
	BL WRITE_UART
	LDR R0,=USART_DR
	LDR R1,[R0]
	CMP R1,#'+'
	BLNE POKER
	LDR R0,=OPER
	ADD R0,R4,R0
	STRB R1,[R0]
	ADD R4,#1
	CMP R1,#0X0D;CUANDO COLOCO MI OPERACION Y DOY ENTER ENTRO A LA PARTE DE INTERPRETAR MIS ASCII
	BEQ REGRESOFINAL
	POP{LR}
	BX LR
REGRESOFINAL
	EOR R7,R7
	ADD R7,#1
	POP{LR}
	BX LR
POKER
	CMP R1,#0X0D
	BEQ PK1
	CMP R1,#'-'
	BNE ERROR
PK1	BX LR

;;;;;;;;;;;;;;;;;;;;;;;;; LUEGO DE GUARDAR MIS NUMEROS, LOS INTERPRETO;;;;;;;;;;;;;;;;;;;;;;;;;;;;;;;;;;;;
;;;;INTERPRETO NUM1

;;;;;;;;;;;;;;;;;;;;;;;;
;;;;;;;;;;;;;;;;;;;;;;;
;;;;;;;;;;;;;;;;;;;;;
;;;;;;;;;;;;;;;;;;;;
;;;;;;;;;;;;;;;;;;
;EMPIEZA CONFIGURACION
;;;;;;;;;;;;;;;;;;;;;;;
;;;;;;;;;;;;;;;;;;;;;
;;;;;;;;;;;;;;;;;;;;
RCC_CONFG
;ENCENDIMOS RELOJES DE PORTB
	LDR R0,=RCC_AHB1ENR
	LDR R1,[R0]
	ORR R1,R1,#(1 << 1);MASCARA PARA ACTIVAR EL PUERTO B
	STR R1,[R0]
	LDR R0,=RCC_APB2ENR
	LDR R1,[R0]
	ORR R1,R1,#0x10;MASCARA PARA ACTIVAR USART1
	STR R1,[R0]
	BX LR
;;;;;;;;;;;;;;;;;;;;;;;;;;;;;;;;;;;;;;;;;;;;;
CONFG_GPIO; 
	LDR R0,=GPIOB_MODER
	LDR R1,[R0]
	ORR R1,#(0XA << 12);
	STR R1,[R0]
	LDR R0,=GPIOB_AFRL;ACTIVAMOS EL AFR7 EN LOS PINES 7 Y 6 
	LDR R1,[R0]
	ORR R1,#(7 << 24)|(7 << 28);
	STR R1,[R0]
	BX LR
CONF_UART;PONEMOS VELOCIDAD DE TRANSMISION
	LDR R0,=USART_BRR;CONFIGURAMOS9600 BAUDIOS
	LDR R1,=0X683
	STR R1,[R0]
	LDR R0,=USART_CR1
	LDR R1,[R0]
	LDR R2,=0X202C;CONFIGURAMOS TRAMA DE 1 BIT STRAT, 8 DE DATA,, SIN PARIDAD, ACTIVAMOS USART, TE Y RE y TE, RE,RXNIE
	ORR R1,R1,R2
	STR R1,[R0];SI REQUERIMOS OTRO QUE NO SEA 1 BIT DE STOP CONFIGURAMOS CR2
	BX LR
CONFNVIC 
	LDR R0,=NVIC_ISER1;HABILITAMOS LA INT DEL USART
	LDR R1,[R0]
	ORR R1,#(1<<5)
	STR R1,[R0]
	BX LR
;;;;;;;;;;;;;;;;;;;;;;;;;;;;;;;;;;;;;;;;;;;;;;;;;;;;;;;;;;;;
;;;;;;;;;;;;;;;;;;;;;;;;;;;;;;;;;;;;;;;;;;;;;;;;;;;;;;;;;;;;
;;;;;;;;;;;;;;;;;;;;;;;;;;;;;;;;;;;;;;;;;;;;;;;;;;;;;;;;;;;;;
;;;;;;;;;;;;;;;;;;;;;;;;;;;;;;;;;;;;;;;;;;;;;;;;;;;;;;;;;;;;;
;TERMINA CONFIGURACION
;;;;;;;;;;;;;;;;;;;;;;;;;;;;
;;;;;;;;;;;;;;;;;;;;;;;;;;;;;;

	ALIGN
	END